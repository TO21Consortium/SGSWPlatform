## kernel/drivers/muic/Kconfig
```kconfig
#
# MUIC devices
#

comment "MUIC configs"

config USE_MUIC
	bool "Using MUIC device driver"
	depends on I2C
	default n
	help
	  If you say yes here you will get support for
	  the MUIC device driver.

config USE_SAFEOUT
	bool "Using SAFEOUT device driver"
	depends on I2C
	default n
	help
	  If you say yes here you will get support for
	  the SAFEOUT device driver.

config MUIC_NOTIFIER
	bool "MUIC notifier support"
	depends on USE_MUIC
	default n
	help
	  If you say yes here you will get support for
	  the MUIC attached device status change notification.

config SAMSUNG_MUIC
	bool "Using samsung MUIC chip driver"
	depends on USE_MUIC
	default n
	help
	  If you say yes here you will get support for the MUIC chip.

config MUIC_ADCMODE_SWITCH_WA
	bool "Using MUIC chip ADC Mode change W/A"
	depends on USE_MUIC
	default n
	help
	  This feature is for MUIC chip's ADC Mode change
	  chip bug Workaround.

config MUIC_RUSTPROOF_ON_USER
	bool "Using MUIC chip Rustproof function ON for User binary"
	depends on USE_MUIC
	default n
	help
	  This feature is for MUIC chip's Rustproof function.

config MUIC_FSA9480
	tristate "FSA9480 USB Switch"
	depends on I2C
	help
	  The FSA9480 is a USB port accessory detector and switch.
	  The FSA9480 is fully controlled using I2C and enables USB data,
	  stereo and mono audio, video, microphone and UART data to use
	  a common connector port.

config MUIC_S2MM001
	bool "Using S2MM001 MUIC"
	depends on USE_MUIC
	default n
	help
	  If you say yes here you will get support for
	  for the S2MM001 MUIC chip.

config MUIC_S2MU005
	bool "Using S2MU005 MUIC"
	depends on USE_MUIC && MFD_S2MU005
	default n
	help
	  If you say yes here you will get support for
	  for the S2MU005 MUIC chip.
```

## kernel/drivers/nfc/Kconfig
```kconfig
#
# Near Field Communication (NFC) devices
#

menu "Near Field Communication (NFC) devices"
	depends on NFC

config NFC_PN533
	tristate "NXP PN533 USB driver"
	depends on USB
	help
	  NXP PN533 USB driver.
	  This driver provides support for NFC NXP PN533 devices.

	  Say Y here to compile support for PN533 devices into the
	  kernel or say M to compile it as module (pn533).

config NFC_WILINK
	tristate "Texas Instruments NFC WiLink driver"
	depends on TI_ST && NFC_NCI
	help
	  This enables the NFC driver for Texas Instrument's BT/FM/GPS/NFC
	  combo devices. This makes use of shared transport line discipline
	  core driver to communicate with the NFC core of the combo chip.

	  Say Y here to compile support for Texas Instrument's NFC WiLink driver
	  into the kernel or say M to compile it as module.

config NFC_TRF7970A
	tristate "Texas Instruments TRF7970a NFC driver"
	depends on SPI && NFC_DIGITAL
	help
	  This option enables the NFC driver for Texas Instruments' TRF7970a
	  device. Such device supports 5 different protocols: ISO14443A,
	  ISO14443B, FeLiCa, ISO15693 and ISO18000-3.

	  Say Y here to compile support for TRF7970a into the kernel or
	  say M  to compile it as a module. The module will be called
	  trf7970a.ko.

config NFC_MEI_PHY
	tristate "MEI bus NFC device support"
	depends on INTEL_MEI && NFC_HCI
	help
	  This adds support to use an mei bus nfc device. Select this if you
	  will use an HCI NFC driver for an NFC chip connected behind an
	  Intel's Management Engine chip.

	  If unsure, say N.

config NFC_SIM
	tristate "NFC hardware simulator driver"
	help
	  This driver declares two virtual NFC devices supporting NFC-DEP
	  protocol. An LLCP connection can be established between them and
	  all packets sent from one device is sent back to the other, acting as
	  loopback devices.

	  If unsure, say N.

config NFC_PORT100
	tristate "Sony NFC Port-100 Series USB device support"
	depends on USB
	depends on NFC_DIGITAL
	help
	  This adds support for Sony Port-100 chip based USB devices such as the
	  RC-S380 dongle.

	  If unsure, say N.

source "drivers/nfc/pn544/Kconfig"
source "drivers/nfc/microread/Kconfig"
source "drivers/nfc/nfcmrvl/Kconfig"
source "drivers/nfc/st21nfca/Kconfig"
source "drivers/nfc/st21nfcb/Kconfig"

config SEC_NFC
        bool "Samsung NFC driver"
        default y
        help
          SAMSUNG NFC Driver.
          This driver provides support for SAMSUNG NFC products.
          You should select your NFC product and interface.

          Say Y here to compile support for SAMSUNG NFC driver into the
          kernel.

choice
        prompt "SEC NFC Products"
        depends on SEC_NFC
        default SEC_NFC_PRODUCT_N5
config SEC_NFC_PRODUCT_N3
        bool "N3"
config SEC_NFC_PRODUCT_N5
        bool "N5"
config SEC_NFC_PRODUCT_N7
	bool "N7"
endchoice

choice
        prompt "SEC NFC Interface"
        depends on SEC_NFC
        default SEC_NFC_IF_I2C
config SEC_NFC_IF_UART
        bool "UART"
config SEC_NFC_IF_I2C
        bool "I2C"
config SEC_NFC_IF_I2C_GPIO
        bool "I2C-GPIO (S/W-I2C)"
        select I2C_ALGOBIT
endchoice

config SEC_NFC_CLK_REQ
        bool "SEC NFC CLK REQ"
        default n
        help
          SAMSUNG NFC CLR REQ feature.
          This feature provides support for SAMSUNG NFC products.
          You should select this feature if your NFC product uses AP CLK.

          Say Y here to compile support for SAMSUNG NFC CLK REQ feature into the
          kernel.

config SEC_NFC_MARGINTIME
        bool "SEC NFC MARGINTIME"
        default n
        help
          SAMSUNG SEC NFC MARGINTIME feature.
          This feature provides support for SAMSUNG NFC products.
          You should select this feature if your NFC product uses AVDD Cap 10uF .

          Say Y here to compile support for SAMSUNG SEC NFC MARGINTIME feature into the
          kernel.

endmenu
```

## kernel/drivers/video/fbdev/exynos/decon_7570/panels/Kconfig
```kconfig
config EXYNOS_DECON_LCD
	depends on EXYNOS_DECON_7570
	bool "Select LCD panel driver"

config EXYNOS_DECON_LCD_S6E8AA0
	depends on EXYNOS_DECON_LCD && EXYNOS_MIPI_DSI
	tristate "S6E8AA0 AMOLED HD LCD driver(720 x 1280)"

config EXYNOS_DECON_LCD_S6E8AA5X01
	depends on EXYNOS_DECON_LCD && EXYNOS_MIPI_DSI
	tristate "S6E8AA5X01 AMOLED HD LCD driver(720 x 1280)"

config EXYNOS_DECON_LCD_S6E36W1X01
	depends on EXYNOS_DECON_LCD && EXYNOS_MIPI_DSI
	tristate "S6E36W1X01 AMOLED HD LCD driver(360 x 360)"

config EXYNOS_DECON_LCD_S6E3AA2
	depends on EXYNOS_DECON_LCD && EXYNOS_MIPI_DSI
	tristate "S6E3AA2 AMOLED HD LCD driver(720 x 1280)"
```
